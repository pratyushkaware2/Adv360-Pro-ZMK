## local-modules/mouse-mode/dts/bindings/behaviors/zmk,behavior-mouse-mode.yaml
```yaml
description: Toggle mouse layer with scrolling, speed controls, dragging and cleanup
compatible: "zmk,behavior-mouse-mode"
include: one_param.yaml
properties:
  layer:
    type: int
    required: true
  movement-behavior:
    type: phandle
    required: true
  precise-behavior:
    type: phandle
    required: true
  fast-behavior:
    type: phandle
    required: true
  scroll-behavior:
    type: phandle
    required: true
```
